## boards/korvo1/Kconfig
```kconfig
menu "PRISM on the Korvo-1"

    config PRISM_LCD_PCLK_MHZ
        int "RGB panel pixel clock (MHz)"
        default 18
        range 1 40
        help
            The panel's pixel clock. 18 MHz is the board-support package's own value
            (BSP_DISPLAY_PANEL_RGB_TIMING). Lower it if the picture shifts: the panel then reads
            less from PSRAM per second, at a lower refresh rate.

    config PRISM_DISPLAY_CPU_COPY
        bool "Copy the bands into the panel buffer on the CPU instead of the PPA"
        default n
        help
            The fallback if the PPA misbehaves: each band PRISM draws is copied into the panel's
            buffer by the CPU, which then cannot draw the next band meanwhile.

    choice PRISM_DISPLAY_ROTATION
        prompt "How the board is held"
        default PRISM_DISPLAY_ROTATION_0
        help
            The frame the apps draw, and where touches land in it. Turned, the frame is 480x800:
            each band is turned by the PPA (or the CPU) as it is copied into the panel's buffer.

        config PRISM_DISPLAY_ROTATION_0
            bool "Landscape (800x480)"
        config PRISM_DISPLAY_ROTATION_90
            bool "Portrait, board turned clockwise: the panel's left edge on top (480x800)"
        config PRISM_DISPLAY_ROTATION_270
            bool "Portrait, board turned counter-clockwise: the panel's right edge on top (480x800)"
    endchoice

    config PRISM_BAND_HEIGHT
        int "Rows per display band"
        default 40 if !PRISM_DISPLAY_ROTATION_0
        default 48
        range 8 96
        help
            PRISM draws the frame in bands of this many rows, two of them in internal SRAM. A
            smaller band frees internal RAM (for Bluetooth, say) at the price of more copies per
            frame. Must divide the frame's height: 480 in landscape, 800 in portrait.

    config PRISM_UI_SCALE_PERCENT
        int "UI scale of the panel apps, in percent"
        range 100 300
        default 150
        help
            100 draws the widgets at their desktop size, 150 one and a half times larger. A finger
            is bigger than a pointer: raise it if the panel is small or the buttons are hard to hit.

endmenu
```

## components/prism_bt/Kconfig
```kconfig
config PRISM_BT_HEADSET_NAME
    string "Headset to connect to at boot (its Bluetooth name, or part of it)"
    default "WH-1000XM3"
    help
        The bonded headset is connected to first; with none bonded, the stack scans for the first
        device whose name contains this string.
```

## main/Kconfig.projbuild
```kconfig
menu "PRISM firmware"

    # scripts/build.sh picks it per firmware (sdkconfig.<app>). Every app but selftest is one of
    # PRISM's own examples, run unchanged (main/CMakeLists.txt); selftest is the board's.
    choice PRISM_APP
        prompt "The app this firmware runs"
        default PRISM_APP_SELFTEST

        config PRISM_APP_SELFTEST
            bool "selftest: the board's on-board checks, on the console"
        config PRISM_APP_WIDGETS
            bool "widgets: PRISM's widget demo on the panel"
        config PRISM_APP_SCOPE
            bool "scope: PRISM's audio scope, on the microphones"
        config PRISM_APP_TONE
            bool "tone: PRISM's tone player, on the speaker and the Bluetooth headset"
        config PRISM_APP_CRDT
            bool "crdt: PRISM's mixer, edited from the panel and from browsers on its own Wi-Fi"
    endchoice

    config PRISM_APP_NAME
        string
        default "selftest" if PRISM_APP_SELFTEST
        default "widgets" if PRISM_APP_WIDGETS
        default "scope" if PRISM_APP_SCOPE
        default "tone" if PRISM_APP_TONE
        default "crdt" if PRISM_APP_CRDT

    config PRISM_CRDT_AP_PASSWORD
        string "The crdt access point's WPA2 password"
        default "prism-crdt"
        depends on PRISM_APP_CRDT
        help
            The password of the "PRISM" access point the crdt firmware opens: 8 to 63
            characters, and the browser has to be given it to join.

endmenu
```
